## drivers/video/samsung/Kconfig
```kconfig
#
# S3C Video configuration
#

config FB_S3C
	tristate "S3C Framebuffer support"
	select FB_CFB_FILLRECT
	select FB_CFB_COPYAREA
	select FB_CFB_IMAGEBLIT
	select FRAMEBUFFER_CONSOLE_DETECT_PRIMARY
	select FB_DEFERRED_IO
	depends on FB && ARCH_S5PV210
	default n
	help
	  This enables support for Samsung Display Controller (FIMD)

config FB_S3C_SPLASH_SCREEN
	bool "SPLASH_SCREEN on LCD"
	depends on FB_S3C
	default y

config FB_S3C_LCD_INIT
	bool "LCD init in kernel"
	depends on FB_S3C
	default y

config FB_S3C_DEBUG
	bool "S3C Framebuffer debug messages"
	depends on FB_S3C

config FB_S3C_TRACE_UNDERRUN
	bool "S3C Framebuffer FIFO underrun trace"
	depends on FB_S3C

config FB_S3C_DEFAULT_WINDOW
	int "Default Window (0-4)"
	depends on FB_S3C
	default "0"
	help
	  This indicates the default window number, and which is used as console framebuffer

config FB_S3C_NR_BUFFERS
	int "Number of frame buffers (1-3)"
	depends on FB_S3C
	default "1"
	help
	  This indicates the number of buffers for pan display,
	  1 means no pan display and
	  2 means the double size of video buffer will be allocated for default window

config FB_S3C_VIRTUAL
	bool "Virtual Screen"
	depends on FB_S3C
	default n
	help
	  This uses 1920 x 1080 virtual screen.

config FB_S3C_X_VRES
	int "xres_virtual"
	depends on FB_S3C && FB_S3C_VIRTUAL
	default "1920"
	help
	  This indicates var.xres_virtual which has to be bigger than var.xres.

config FB_S3C_Y_VRES
	int "yres_virtual"
	depends on FB_S3C && FB_S3C_VIRTUAL
	default "1080"
	help
	  This indicates var.yres_virtual which has to be bigger than var.yres.

config VIDEO_SAMSUNG_MEMSIZE_FIMD
	int "Memory size in kbytes for FIMD"
	depends on FB_S3C
	default "3072"

config FB_URBETTER_SERIAL
	bool
	depends on (MACH_SMDKC110 || MACH_SMDKV210)

choice
prompt "Select LCD Type"
depends on FB_S3C
default FB_S3C_UT7GM

config FB_S3C_INNOLUX430
	bool "Innolux 4.3 inch (480x272)"
	depends on (MACH_SMDKC110 || MACH_SMDKV210)
	select BACKLIGHT_PWM
	select FB_URBETTER_SERIAL
	---help---
	  This enables support for Sharp 4.3 inch LCD panel

config FB_S3C_UT7GM
	bool "UT7GM (7inch 800x480)"
	depends on (MACH_SMDKC110 || MACH_SMDKV210)
	select BACKLIGHT_PWM
	select FB_URBETTER_SERIAL
	---help---
	TBA

config FB_S3C_UTAUO104
	bool "UTAUO (10.4inch 800x600)"
	depends on (MACH_SMDKC110 || MACH_SMDKV210)
	select BACKLIGHT_PWM
	select FB_URBETTER_SERIAL
	---help---
	TBA
	
config FB_S3C_UTLTD121
	bool "UTLTD121 (12.1inch 1024x768)"
	depends on (MACH_SMDKC110 || MACH_SMDKV210)
	select BACKLIGHT_PWM
	select FB_URBETTER_SERIAL
	---help---
	TBA
		
config FB_S3C_LTE480WV
	bool "LTE480WV"
	depends on (MACH_SMDKC110 || MACH_SMDKV210)
	select BACKLIGHT_PWM
	select FB_URBETTER_SERIAL
	help
	  This enables support for Samsung LTE480WV 4.8\" WVGA LCD panel
endchoice

config FB_S3C_TL2796
        bool "TL2796"
	depends on (MACH_SMDKC110 || MACH_SMDKV210)
	select SPI
	select SPI_GPIO
	select SPI_BITBANG
	select BACKLIGHT_TL2796_AMOLED

	---help---
	  This enables support for Samsung TL2796 WVGA LCD panel

config FB_S3C_HT101HD1
	bool "HT101HD1"
	depends on MACH_SMDKV210 || MACH_SMDKC110
	help
	  This enables support for HT101HD1 WXVGA(1366*768) LCD panel
```
